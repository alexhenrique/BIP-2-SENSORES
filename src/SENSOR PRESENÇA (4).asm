  #INCLUDE <P16F628A.INC>
__CONFIG _CP_OFF & _WDT_OFF & _PWRTE_ON & _BODEN_ON & _MCLRE_ON & _INTRC_OSC_NOCLKOUT  & _LVP_OFF
;__CONFIG _BODEN_ON & _CP_OFF & _PWRTE_ON & _WDT_OFF & _LVP_OFF & _MCLRE_ON & _XT_OSC
;;;;;;;;;;;;;;;;;;;;;;;;;;;;;;;;;;;
;PAGINAÇÃO DE MEMORIA
;;;;;;;;;;;;;;;;;;;;;;;;;;;;;;;;;;;
  #DEFINE      BANK0       BCF     STATUS,RP0
  #DEFINE      BANK1       BSF     STATUS,RP0
;;;;;;;;;;;;;;;;;;;;;;;;;;;;;;;;;;;
;VARIAVEIS
;;;;;;;;;;;;;;;;;;;;;;;;;;;;;;;;;;;
CBLOCK 0X20
	CELL1
	CELL2
	CELL3
	CELL4
	DECA1
	DECA2
	DECA3
ENDC
;ENTRADAS
#DEFINE    SENSOR1  PORTA,0
#DEFINE    SENSOR2  PORTA,1
#DEFINE    SENSOR3  PORTA,2
#DEFINE    SENSOR4  PORTA,3
#DEFINE    DIP1     PORTB,4
#DEFINE    DIP2     PORTB,5
#DEFINE    DIP3     PORTB,6
#DEFINE    DIP4     PORTB,7
;SAIDAS
#DEFINE    SAIDA1    PORTB,0
#DEFINE    SAIDA2    PORTB,1
#DEFINE    SAIDA3    PORTB,2
#DEFINE    SAIDA4    PORTB,3
;;;;;;;;;;;;;;;;;;;;;;;;;;;;;;;;;;;
;VETOR RESET
;;;;;;;;;;;;;;;;;;;;;;;;;;;;;;;;;;;
ORG       	0X00
GOTO	    INICIO
;;;;;;;;;;;;;;;;;;;;;;;;;;;;;;;;;;;
;INTERRUPÇÃO
;;;;;;;;;;;;;;;;;;;;;;;;;;;;;;;;;;;
ORG 0X04
RETFIE			
;;;;;;;;;;;;;;;;;;;;;;;;;;;;;;;;;;;
;INICIO DO PROGRAMA
;;;;;;;;;;;;;;;;;;;;;;;;;;;;;;;;;;;
INICIO
	BANK0
	CLRF  PORTA
	CLRF  PORTB
	CLRF  CELL1
	CLRF  CELL2
	CLRF  CELL3
	CLRF  CELL4
	CLRF  DECA1
	CLRF  DECA2
	CLRF  DECA3
	BANK1
	MOVLW  b'00001111'
	MOVWF  TRISA
	MOVLW  b'11110000'
	MOVWF  TRISB
	MOVLW  b'1000000'
	MOVWF  OPTION_REG
	MOVLW  b'0000000'
	MOVWF  INTCON
	BANK0
	MOVLW  b'00000111'
	MOVWF  CMCON
;;;;;;;;;;;;;;;;;;;;;;;;;;;;;;;;;;;
;ROTINA PRINCIPAL DO PROGRAMA
;;;;;;;;;;;;;;;;;;;;;;;;;;;;;;;;;;;
MAIN
	BTFSC       SENSOR1			
	CALL        SETA1
	BTFSC       SENSOR2		
	CALL        SETA2
	BTFSC       SENSOR3			
	CALL        SETA3
	BTFSC       SENSOR4		
	CALL        SETA4
	CALL		DELAY_CALL
	MOVLW		b'11111100' 			;ATRIBUI VALOR A DECALL
	MOVWF		DECA3
LOS	
	DECFSZ		DECA3,F
	GOTO		LOS
	GOTO 		MAIN
;;;;;;;;;;;;;;;;;;;;;;;;;;;;;;;;;;;
SETA1
	BTFSS		DIP1
	GOTO		CURTO1
	GOTO		LONGO1
CURTO1
	MOVLW		b'01111111' 	;VALOR PARA TEMPO CURTO
	MOVWF		CELL1
	RETURN
LONGO1
	MOVLW		b'11111111'		;VALOR PARA TEMPO LONGO
	MOVWF		CELL1
	RETURN	
;;;;;;;;;;;;;;;;;;;;;;;;;;;;;;;;;;;
SETA2
	BTFSS		DIP2
	GOTO		CURTO2
	GOTO		LONGO2
CURTO2
	MOVLW		b'01111111'	;VALOR PARA TEMPO CURTO
	MOVWF		CELL2
	RETURN
LONGO2
	MOVLW		b'11111111'	;VALOR PARA TEMPO LONGO
	MOVWF		CELL2
	RETURN	
;;;;;;;;;;;;;;;;;;;;;;;;;;;;;;;;;;;
SETA3
	BTFSS		DIP3
	GOTO		CURTO3
	GOTO		LONGO3
CURTO3
	MOVLW		b'01111111'	;VALOR PARA TEMPO CURTO
	MOVWF		CELL3
	RETURN
LONGO3
	MOVLW		b'11111111'		;VALOR PARA TEMPO LONGO
	MOVWF		CELL3
	RETURN	
;;;;;;;;;;;;;;;;;;;;;;;;;;;;;;;;;;;
SETA4
	BTFSS		DIP4
	GOTO		CURTO4
	GOTO		LONGO4
CURTO4
	MOVLW		b'01111111'		;VALOR PARA TEMPO CURTO
	MOVWF		CELL4
	RETURN
LONGO4
	MOVLW		b'11111111'		;VALOR PARA TEMPO LONGO
	MOVWF		CELL4
	RETURN	

;;;;;;;;;;;;;;;;;;;;;;;;;;;;;;;;;;;;;;;;;;;;;;;;;;;;;;;;;;;;;;;;;;;;;;	
;;;;;;;;;;;;;;;;;;;;;;;;;;;;;;;;;;;;;;;;;;;;;;;;;;;;;;;;;;;;;;;;;;;;;;
DELAY_CALL
	MOVLW	b'11111111'  ;ATRIBUI VALOR A DECALL
	MOVWF	DECA1
	MOVLW	b'01111111'  ;ATRIBUI VALOR A DECALL
	MOVWF	DECA2
LOOPS	
	DECFSZ	DECA1,F
	GOTO	LOOPS
	DECFSZ	DECA2,F  	;INCREMENTA VALOR
	GOTO 	LOOPS
	CALL 	CALL_OUT
RETURN

;;;;;;;;;;;;;;;;;;;;;;;;;;;;;;;;;;;;;;;;;;;;;;;;;;;;;;;;;;;;;;;;;;;;;;	
;;;;;;;;;;;;;;;;;;;;;;;;;;;;;;;;;;;;;;;;;;;;;;;;;;;;;;;;;;;;;;;;;;;;;;
CALL_OUT 	
	MOVF 	CELL1,F		;TESTA SE VALOR MAIOR QUE ZERO
	BTFSS	STATUS,Z	;
	GOTO	ATIVA1		;SE SIM, ATIVA SAIDA E DECREMENTA
	BCF		SAIDA1		;SE NÃO, DESLIGA SAIDA
	GOTO	OUT2	
ATIVA1
	BSF 	SAIDA1		;SE SIM, ATIVA SAIDA 
	DECF	CELL1,F		;E DECREMENTA	
;;;;;;;;;;;;;;;;;;;;;;;;;;;;;;;;;;;
OUT2 	
	MOVF 	CELL2,F		;TESTA SE VALOR MAIOR QUE ZERO
	BTFSS	STATUS,Z	;
	GOTO	ATIVA2		;SE SIM, ATIVA SAIDA E DECREMENTA
	BCF		SAIDA2		;SE NÃO, DESLIGA SAIDA
	GOTO	OUT3		
ATIVA2
	BSF 	SAIDA2		;SE SIM, ATIVA SAIDA 
	DECF	CELL2,F		;E DECREMENTA	
;;;;;;;;;;;;;;;;;;;;;;;;;;;;;;;;;;;
OUT3 	
	MOVF 	CELL3,F		;TESTA SE VALOR MAIOR QUE ZERO
	BTFSS	STATUS,Z	;
	GOTO	ATIVA3		;SE SIM, ATIVA SAIDA E DECREMENTA
	BCF		SAIDA3		;SE NÃO, DESLIGA SAIDA
	GOTO	OUT4			
ATIVA3
	BSF 	SAIDA3		;SE SIM, ATIVA SAIDA 
	DECF	CELL3,F		;E DECREMENTA			
;;;;;;;;;;;;;;;;;;;;;;;;;;;;;;;;;;;
OUT4 	
	MOVF 	CELL4,F		;TESTA SE VALOR MAIOR QUE ZERO
	BTFSS	STATUS,Z	;
	GOTO	ATIVA4		;SE SIM, ATIVA SAIDA E DECREMENTA
	BCF		SAIDA4		;SE NÃO, DESLIGA SAIDA
	RETURN				;RETORNA
ATIVA4
	BSF 	SAIDA4		;SE SIM, ATIVA SAIDA 
	DECF	CELL4,F		;E DECREMENTA
	RETURN		
;;;;;;;;;;;;;;;;;;;;;;;;;;;;;;;;;;;
END